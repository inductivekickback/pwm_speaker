/*
 * Copyright (c) 2021 Daniel Veilleux
 *
 * SPDX-License-Identifier: Apache-2.0
 */

#include <kernel.h>
#include <string.h>
#include <zephyr.h>
#include <device.h>
#include <stdio.h>
#include <sys/__assert.h>

#include <drivers/speaker.h>

#include <logging/log.h>

LOG_MODULE_REGISTER(main, LOG_LEVEL_DBG);

static bool sound_finished;

// "Collect point 00"
static const uint8_t sound_0[] = {
     0x7b,
     0x7e, 0x7b, 0x7e, 0x7a, 0x7f, 0x7a, 0x80, 0x78, 0x83, 0x78, 0x71, 0x92, 0x75, 0x78, 0x81, 0x6d, 0x8e, 0x81, 0x63, 0x97,
     0x7b, 0x6d, 0x85, 0x85, 0x63, 0x90, 0x81, 0x6d, 0x82, 0x82, 0x71, 0x89, 0x81, 0x69, 0x89, 0x81, 0x6a, 0x8c, 0x80, 0x6c,
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     0x7c, 0x7d, 0x7c, 0x7d, 0x7d, 0x7c, 0x7c, 0x7c, 0x7d, 0x7d, 0x7d, 0x7c, 0x7c, 0x7c, 0x7c, 0x7d, 0x7d, 0x7d, 0x7c, };

void speaker_callback(speaker_event_t event)
{
     LOG_INF("speaker_callback(%d)", event);
     sound_finished = true;
}

void main(void)
{
    const struct device *dev;

    if (IS_ENABLED(CONFIG_LOG_BACKEND_RTT)) {
        /* Give RTT log time to be flushed before executing tests */
        k_sleep(K_MSEC(500));
    }

    dev = device_get_binding("thingy_speaker");
    if (dev == NULL) {
        LOG_ERR("Failed to get speaker dev binding");
        return;
    }
    LOG_INF("Speaker dev is %p, name is %s", dev, dev->name);

    int err = speaker_pcm_play(dev, sound_0, sizeof(sound_0), speaker_callback);
    if (err) {
      LOG_ERR("speaker_tone_play failed: %d", err);
    }

    for (int i=0; i<15 ; i++) {
      sound_finished = false;
      int err = speaker_tone_play(dev, 200 * (i + 2), 500, 100, speaker_callback);
      if (err) {
        LOG_ERR("speaker_pcm_play failed: %d", err);
      }
      while(!sound_finished) {}
    }

    while (1) {
        k_sleep(K_MSEC(100));
    }
}
